
AUXR	DATA	8EH
ID	EQU	0FDF9H	; STC8A8K64S4A10
;ID	EQU	0EFF9H	; STC8A8K60S4A10
;ID	EQU	07FF9H	; STC8A8K32S4A10
;ID	EQU	03FF9H	; STC8A8K16S4A10

BUSY	BIT	20H.0

	ORG	0000H
	LJMP	MAIN
	ORG	0023H
	LJMP	UART_ISR

	ORG	0100H

UART_ISR:
	JNB	TI,CHKRI
	CLR	TI
	CLR	BUSY
CHKRI:
	JNB	RI,UARTISR_EXIT
	CLR	RI
UARTISR_EXIT:
	RETI

UART_INIT:
	MOV	SCON,#50H
	MOV	TMOD,#00H
	MOV	TL1,#0E8H	;65536-11059200/115200/4=0FFE8H
	MOV	TH1,#0FFH
	SETB	TR1
	MOV	AUXR,#40H
	CLR	BUSY
	RET

UART_SEND:
	JB	BUSY,$
	SETB	BUSY
	MOV	SBUF,A
	RET

MAIN:
	MOV	SP,#3FH

	LCALL	UART_INIT
	SETB	ES
	SETB	EA

	MOV	DPTR,#ID
	MOV	R1,#7
NEXT:	CLR	A
	MOVC	A,@A+DPTR
	LCALL	UART_SEND
	INC	DPTR
	DJNZ	R1,NEXT

LOOP:
	JMP	LOOP

	END

